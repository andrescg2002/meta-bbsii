## conf/bblayers.conf
```bitbake
# POKY_BBLAYERS_CONF_VERSION is increased each time build/conf/bblayers.conf
# changes incompatibly
POKY_BBLAYERS_CONF_VERSION = "2"

BBPATH = "${TOPDIR}"
BBFILES ?= ""

BBLAYERS ?= " \
  /home/${USER}/yocto/poky/meta \
  /home/${USER}/yocto/poky/meta-poky \ 
  /home/${USER}/yocto/meta-bbsii \  
  /home/${USER}/yocto/meta-ti \      
  "
```

## conf/distro/magno.conf
```bitbake
require conf/distro/poky.conf      

DISTRO = "magno"
DISTRO_NAME = "Magno IoT - DCT Linux Distribution"
DISTRO_VERSION = "1.1"
#DISTRO_CODENAME = "bsc"
#DISTRO_FEATURES_append = " alsa usbhost usbgadget keyboard bluetooth"  
#SDK_VENDOR = "-bsecdistsdk"      
#SDK_VERSION := "${@'${DISTRO_VERSION}'.replace('snapshot-${DATE}','snapshot')}"      
#MAINTAINER = "bsecdist "      
#INHERIT += "buildhistory"      
#BUILDHISTORY_COMMIT = "1"  
```

## conf/machine/syrusrouter.conf
```bitbake
#@TYPE: Machine
#@NAME: AM335x EVM "Evaluation module"
#@DESCRIPTION: Machine configuration for the TI AM335x EVM

require conf/machine/include/ti33x.inc

#MACHINE_GUI_CLASS = "smallscreen"
#MACHINE_FEATURES += "touchscreen"

#Specifies the name of the generated Linux kernel device tree (i.e. the .dtb) file.
#Kernel device tree is a data structure describing the hardware components of a particualr device
KERNEL_DEVICETREE = "am335x-boneblack.dtb"

SPL_BINARY = "MLO"
UBOOT_SUFFIX = "img"

#A space-separated list of files installed into the boot partition when preparing an image
IMAGE_BOOT_FILES = "u-boot.${UBOOT_SUFFIX} MLO"

#Specifies the formats the OpenEmbedded build system uses during the build when creating the root filesystem
IMAGE_FSTYPES += "tar.xz"
#Defines a serial console (TTY) to enable using getty. Provide a value that specifies the baud rate followed by the TTY device name separated by a space.
#You cannot specify more than one TTY device:
#Normally AM335 boards use ttyS0
SERIAL_CONSOLE = "115200 ttyS0"

# Refine the list of device targets for ti-pdk class recipes
TI_PDK_LIMIT_BOARDS = "bbbAM335x"

#Warning!!! this line causes the CRC Warning when system starts
#UBOOT_MACHINE = "am335x_boneblack_config"

# UBI information.  Note that this is board and kernel specific.  Changes
# in your kernel port may require changes in these variables.  For more
# details about this board please see
# http://processors.wiki.ti.com/index.php/UBIFS_Support

# do ubiattach /dev/ubi_ctrl -m 7 -O 2048
# From dmesg:
# UBI: smallest flash I/O unit:    2048
# UBI: logical eraseblock size:    126976 bytes
# from ubiattach stdout:
# UBI device number 0, total 1988 LEBs
MKUBIFS_ARGS = "-F -m 2048 -e 126976 -c 8200"

# do ubiattach /dev/ubi_ctrl -m 7 -O 2048
# from dmesg:
# UBI: smallest flash I/O unit:    2048
# UBI: physical eraseblock size:   131072 bytes (128 KiB)
# UBI: sub-page size:              512
# UBI: VID header offset:          2048 (aligned 2048)
UBINIZE_ARGS = "-m 2048 -p 128KiB -s 512 -O 2048"

PREFERRED_PROVIDER_virtual/bootloader = "u-boot"
PREFERRED_PROVIDER_u-boot = "u-boot"

EXTRA_IMAGEDEPENDS += "u-boot"
```
